## meta-barbone/conf/layer.conf
```bitbake
#Classes
BBPATH := "${BBPATH}:${LAYERDIR}"

#our bbfiles to include
BBFILES := "${BBFILES} ${LAYERDIR}/recepies-*/*/*.bb"

BBFILE_COLLECTIONS += "hello"
BBFILE_PATERN_hello := "^${LAYERDIR}/"
BBFILE_PRIORITY_hello = "5"
```

## meta-daniel/conf/layer.conf
```bitbake
#Classes
BBPATH := "${BBPATH}:${LAYERDIR}"

#our bbfiles to include
BBFILES := "${BBFILES} ${LAYERDIR}/recepies-*/*/*.bb"
```
